## config/boards/shields/kiwi36/Kconfig.defconfig
```kconfig
# Copyright (c) 2023 The ZMK Contributors
# SPDX-License-Identifier: MIT

if SHIELD_KIWI36_DONGLE || SHIELD_KIWI36_DONGLE_YADS

# Name must be less than 16 characters long!
config ZMK_KEYBOARD_NAME
    default "Kiwi36 Dongle"

config ZMK_SPLIT_ROLE_CENTRAL
    default y

config ZMK_USB
    default y

config ZMK_SPLIT_BLE_CENTRAL_PERIPHERALS
    default 4

# Dongle outputs via USB — needs peripherals + 1 for internal BLE scan/connect overhead
config BT_MAX_CONN
    default 5

config BT_MAX_PAIRED
    default 5

endif


if SHIELD_KIWI36_LEFT

config ZMK_SPLIT_ROLE_CENTRAL
    default y

endif

if SHIELD_KIWI36_LEFT || SHIELD_KIWI36_RIGHT || SHIELD_KIWI36_DONGLE || SHIELD_KIWI36_DONGLE_YADS

config ZMK_SPLIT
default y

config ZMK_BLE
default y

endif # SHIELD_KIWI36_LEFT || SHIELD_KIWI36_RIGHT || SHIELD_KIWI36_DONGLE || SHIELD_KIWI36_DONGLE_YADS

if SHIELD_KIWI36_LEFT || SHIELD_KIWI36_RIGHT

if ZMK_DISPLAY

config I2C
    default y

config SSD1306
    default y

endif # ZMK_DISPLAY

if LVGL

config LV_Z_VDB_SIZE
    default 64

config LV_DPI_DEF
    default 148

config LV_Z_BITS_PER_PIXEL
    default 1

choice LV_COLOR_DEPTH
    default LV_COLOR_DEPTH_1
endchoice

endif # LVGL

endif # SHIELD_KIWI36_LEFT || SHIELD_KIWI36_RIGHT
```

## config/west.yml
```yaml
manifest:
  remotes:
    - name: zmkfirmware
      url-base: https://github.com/zmkfirmware
    - name: carrefinho
      url-base: https://github.com/carrefinho
    - name: janpfischer
      url-base: https://github.com/janpfischer
  projects:
    - name: zmk
      remote: zmkfirmware
      revision: v0.3.0
      import: app/west.yml
    - name: prospector-zmk-module
      remote: carrefinho
      revision: main
      path: optional/prospector-zmk-module
      groups:
        - dongle
    - name: zmk-dongle-screen
      remote: janpfischer
      revision: main
      path: optional/zmk-dongle-screen
      groups:
        - dongle
  self:
    path: config
```
